## BackEnd/yocto-files/conf/bblayers.conf
```bitbake
# POKY_BBLAYERS_CONF_VERSION is increased each time build/conf/bblayers.conf
# changes incompatibly
POKY_BBLAYERS_CONF_VERSION = "2"

BBPATH = "${TOPDIR}"
BBFILES ?= ""

BBLAYERS ?= " \
  /home/samastua/Documents/poky-dunfell-23.0.21/meta \
  /home/samastua/Documents/poky-dunfell-23.0.21/meta-poky \
  /home/samastua/Documents/poky-dunfell-23.0.21/meta-yocto-bsp \
  /home/samastua/Documents/poky-dunfell-23.0.21/meta-raspberrypi \
  /home/samastua/Documents/poky-dunfell-23.0.21/meta2-webcam \
  /home/samastua/Documents/poky-dunfell-23.0.21/meta-python \
  /home/samastua/Documents/poky-dunfell-23.0.21/meta-oe \
  "
```
